/*
 * SDA > A4     SCL > A5     VCC > 5V      GND
 *
 * Car 12V > 100k > A1
 *              33k > GND
 *
 * Temp Signal > 100k > A0
 *                    0.1uF* > GND
 */

#include <Wire.h>
#include <Adafruit_GFX.h>
#include <Adafruit_SSD1306.h>

#define SCREEN_WIDTH 128
#define SCREEN_HEIGHT 64

Adafruit_SSD1306 oled(SCREEN_WIDTH, SCREEN_HEIGHT, &Wire, -1);

// 'CivicEFHatch', 128x64px
const unsigned char civicEFBitmapCivicEFHatch [] PROGMEM = {
  0x00, 0x00, 0x00, 0x00, 0x00, 0x00, 0x00, 0x00, 0x1f, 0x80, 0x00, 0x00, 0x00, 0x00, 0x00, 0x00, 
  0x00, 0x00, 0x00, 0x00, 0x00, 0x00, 0x00, 0x03, 0xf0, 0x00, 0x00, 0x00, 0x00, 0x00, 0x00, 0x00, 
  0x00, 0x00, 0x00, 0x00, 0x00, 0x00, 0x00, 0x1f, 0xff, 0xff, 0xff, 0xff, 0xff, 0xff, 0xfc, 0x00, 
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  0x00, 0x00, 0x00, 0x00, 0x00, 0x00, 0x00, 0x00, 0x00, 0x00, 0x00, 0x00, 0x00, 0x00, 0x00, 0x00
};


// ---- COOLANT CALIBRATION (EDIT THESE) ----
// Fill these in from your measurements:
const int   CLT_RAW_COLD = 565;   // <-- replace with your cold raw A0 reading
const float CLT_F_COLD   = 100.0;  // <-- replace with your ambient temp (F)

const int   CLT_RAW_HOT  = 420;   // <-- replace with your hot stabilized raw A0 reading
const float CLT_F_HOT    = 159.5; // <-- replace with your measured hot temp (F)


int buttonState = 0;
bool displayMode = false;


float mapFloat(float x, float in_min, float in_max, float out_min, float out_max) {
  if (in_max - in_min == 0) return out_min;
  return (x - in_min) * (out_max - out_min) / (in_max - in_min) + out_min;
}

float estimateCoolantF(int raw) {
  // On most Honda sender/gauge circuits: raw tends to go DOWN as temp goes UP
  float f = mapFloat((float)raw, (float)CLT_RAW_COLD, (float)CLT_RAW_HOT, CLT_F_COLD, CLT_F_HOT);

  // Clamp to sane range
  if (f < -40) f = -40;
  if (f > 260) f = 260;
  return f;
}


void setup() {
  if (!oled.begin(SSD1306_SWITCHCAPVCC, 0x3C)) {
    while (true) { }
  }

  // Boot Logo
  delay(2000);
  oled.clearDisplay();
  oled.drawBitmap(0, 0, civicEFBitmapCivicEFHatch, 128, 64, WHITE);
  oled.display();

  pinMode(2, OUTPUT);
  pinMode(3, OUTPUT);

  // Cycle through LEDs
  digitalWrite(3, HIGH);
  delay(250);
  digitalWrite(2, HIGH);
  delay(250);

  pinMode(4, INPUT);
  pinMode(A0, INPUT); // Coolant temp
  pinMode(A1, INPUT); // System voltage

  // Optional but recommended: stabilize ADC reference
  analogReference(DEFAULT); // uses 5V (Uno/Nano)

  // Optional: dummy reads to stabilize the ADC
  analogRead(A0);
  analogRead(A1);

  delay(100);
  digitalWrite(2, LOW);
  digitalWrite(3, LOW);
}

void loop() {
  buttonState = digitalRead(4);

  int rawV = analogRead(A1);
  float volts = rawV * (5.0 / 1023.0) * 3.5;

  int rawTemp = analogRead(A0);
  float Temp = estimateCoolantF(rawTemp);

  // Warning Lights
  if(volts <= 12) {
    digitalWrite(3, HIGH);
  } else {
    digitalWrite(3, LOW);
  }

  if(Temp >= 215) {
    digitalWrite(2, HIGH);
  } else {
    digitalWrite(2, LOW);
  }

  if (buttonState == HIGH) {
    displayMode = !displayMode;
    delay(100);
  }

  if(displayMode){
    oled.clearDisplay();
    oled.drawBitmap(0, 0, civicEFBitmapCivicEFHatch, 128, 64, WHITE);
    oled.display();
  } else {
    
    float systemVolts = volts;
    float cltEstF     = Temp;

    // ---- SCREEN ----
    oled.clearDisplay();

    // Header
    oled.setTextColor(WHITE);
    oled.setTextSize(1);
    oled.setCursor(0, 0);
    oled.print("ENGINE MONITOR");
    oled.drawLine(0, 10, 127, 10, WHITE);

    // Voltage (left)
    oled.setCursor(0, 14);
    oled.print("VOLTAGE");
    oled.setCursor(0, 24);
    oled.setTextSize(2);
    oled.print(systemVolts, 1);
    oled.setTextSize(1);
    oled.print("V");

    // Coolant temp (right)
    oled.setCursor(74, 14);
    oled.print("COOLANT");
    oled.setCursor(74, 24);
    oled.setTextSize(2);
    oled.print((int)(cltEstF + 0.5));
    oled.setTextSize(1);
    oled.print("F");

    // Footer
    oled.drawLine(0, 44, 127, 44, WHITE);
    oled.setCursor(0, 48);
    oled.print("@_SPOTECH");

    oled.display();

    delay(200);
  }
}
